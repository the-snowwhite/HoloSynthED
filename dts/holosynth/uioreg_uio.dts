/dts-v1/ /plugin/;

/ {
   fragment@0 {
      target-path = "/soc/base_fpga_region";
		#address-cells = <1>;
		#size-cells = <1>;
      __overlay__ {
			#address-cells = <1>;
			#size-cells = <1>;

			external-fpga-config;

			uioreg_io_0: uio-socfpg0@0x40000 {
				compatible = "uioreg_io,generic-uio,ui_pdrv";
				reg = <0x40000 0x10000>;
				interrupt-parent = <0x2>;
				interrupts = <0 43 4>;
				clocks = <&osc1>;
				address_width = <14>;
				data_width = <32>;
			};
		};
	};
};


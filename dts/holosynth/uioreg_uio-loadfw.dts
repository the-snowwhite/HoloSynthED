/dts-v1/ /plugin/;

/ {
   fragment@0 {
      target-path = "/soc/base_fpga_region";
		#address-cells = <1>;
		#size-cells = <1>;
      __overlay__ {

			firmware-name = "socfpga/DE1_SOC_Linux_FB.rbf";

			#address-cells = <1>;
			#size-cells = <1>;
				
			ranges = <0x00040000 0xff240000 0x00010000>;
			fpga-bridges = <&fpga_bridge0>, <&fpga_bridge1>;
		
			uioreg_io_0: uio-socfpg0@0x40000 {
				compatible = "uioreg_io,generic-uio,ui_pdrv";
				reg = <0x40000 0x10000>;
				interrupt-parent = <0x2>;
				interrupts = <0 43 4>;
				clocks = <&osc1>;
				address_width = <14>;
				data_width = <32>;
			};
		};
	};
};

